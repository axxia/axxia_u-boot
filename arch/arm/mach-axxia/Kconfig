## arch/arm/mach-axxia/Kconfig
```kconfig
if TARGET_AXXIA

choice
	prompt "Axxia SoC Select"
	default TARGET_AXM5600

config TARGET_AXM5600
       bool "Axxia AXM5600"
       select ARM64
       select SUPPORT_SPL
       select SPL

config TARGET_AXC6700
       bool "Axxia AXC6700"
       select ARM64
       select SUPPORT_SPL
       select SPL

endchoice

choice
	prompt "Axxia System Type"
	default TARGET_HARDWARE

config TARGET_SIMULATION
       bool "Axxia Simulation"

config TARGET_EMULATION
       bool "Axxia Emulation"

config TARGET_HARDWARE
       bool "Axxia Hardware"

endchoice

source "arch/arm/mach-axxia/axm5600/Kconfig"
source "arch/arm/mach-axxia/axc6700/Kconfig"

endif
```

## arch/arm/mach-axxia/axc6700/Kconfig
```kconfig
if TARGET_AXC6700

config SYS_SOC
       default "axc6700"

source "board/axxia/axc6700/Kconfig"

endif
```

## arch/arm/mach-axxia/axm5600/Kconfig
```kconfig
if TARGET_AXM5600

config SYS_SOC
       default "axm5600"

source "board/axxia/axm5600/Kconfig"

endif
```

## board/axxia/axc6700/Kconfig
```kconfig
if TARGET_AXC6700

config SYS_VENDOR
       default "axxia"

config SYS_BOARD
       default "axc6700"

config SYS_CONFIG_NAME
       default "axc6700"

endif
```

## board/axxia/axm5600/Kconfig
```kconfig
if TARGET_AXM5600

config SYS_VENDOR
       default "axxia"

config SYS_BOARD
       default "axm5600"

config SYS_CONFIG_NAME
       default "axm5600"

endif
```

## board/lsi/axm55xx/Kconfig
```kconfig
if TARGET_AXM55XX

config SYS_CPU
	default "armv7"

config SYS_BOARD
	default "axm55xx"

config SYS_VENDOR
	default "lsi"

config SYS_SOC
	default "axm55xx"

config SYS_CONFIG_NAME
	default "axm55xx"

endif

if TARGET_AXM55XX_EMU

config SYS_CPU
	default "armv7"

config SYS_BOARD
	default "axm55xx"

config SYS_VENDOR
	default "lsi"

config SYS_SOC
	default "axm55xx"

config SYS_CONFIG_NAME
	default "axm55xx_emu"

endif

if TARGET_AXM55XX_SIM

config SYS_CPU
	default "armv7"

config SYS_BOARD
	default "axm55xx"

config SYS_VENDOR
	default "lsi"

config SYS_SOC
	default "axm55xx"

config SYS_CONFIG_NAME
	default "axm55xx_sim"

endif
```

## board/lsi/axm56xx/Kconfig
```kconfig
if TARGET_AXM56XX

config SYS_CPU
	default "armv8"

config SYS_BOARD
	default "axm56xx"

config SYS_VENDOR
	default "lsi"

config SYS_SOC
	default "axm56xx"

config SYS_CONFIG_NAME
	default "axm56xx"

endif

if TARGET_AXM56XX_EMU

config SYS_CPU
	default "armv8"

config SYS_BOARD
	default "axm56xx"

config SYS_VENDOR
	default "lsi"

config SYS_SOC
	default "axm56xx"

config SYS_CONFIG_NAME
	default "axm56xx_emu"

endif

if TARGET_AXM56XX_SIM

config SYS_CPU
	default "armv8"

config SYS_BOARD
	default "axm56xx"

config SYS_VENDOR
	default "lsi"

config SYS_SOC
	default "axm56xx"

config SYS_CONFIG_NAME
	default "axm56xx_sim"

endif
```

## board/lsi/axmLf/Kconfig
```kconfig
if TARGET_AXMLF

config SYS_CPU
	default "armv8"

config SYS_BOARD
	default "axmLf"

config SYS_VENDOR
	default "lsi"

config SYS_SOC
	default "axmLf"

config SYS_CONFIG_NAME
	default "axmLf"

endif

if TARGET_AXMLF_EMU

config SYS_CPU
	default "armv8"

config SYS_BOARD
	default "axmLf"

config SYS_VENDOR
	default "lsi"

config SYS_SOC
	default "axmLf"

config SYS_CONFIG_NAME
	default "axmLf_emu"

endif

if TARGET_AXMLF_SIM

config SYS_CPU
	default "armv8"

config SYS_BOARD
	default "axmLf"

config SYS_VENDOR
	default "lsi"

config SYS_SOC
	default "axmLf"

config SYS_CONFIG_NAME
	default "axmLf_sim"

endif
```

## configs/axc6700_defconfig
```kconfig
CONFIG_ARM=y
CONFIG_TARGET_AXXIA=y
CONFIG_TARGET_AXC6700=y
CONFIG_AXXIA_GPIO=y
CONFIG_AXXIA_SPI=y
```

## configs/axc6700_sim_defconfig
```kconfig
CONFIG_ARM=y
CONFIG_TARGET_AXXIA=y
CONFIG_TARGET_AXC6700=y
CONFIG_TARGET_SIMULATION=y
```

## configs/axm5600_defconfig
```kconfig
CONFIG_ARM=y
CONFIG_TARGET_AXXIA=y
CONFIG_NET_ONCE=y
CONFIG_AXXIA_GPIO=y
CONFIG_AXXIA_SPI=y
CONFIG_FAT_WRITE=y
CONFIG_CMD_FAT=y
CONFIG_HUSH_PARSER=y
```

## configs/axm5600_emu_defconfig
```kconfig
CONFIG_ARM=y
CONFIG_TARGET_AXXIA=y
CONFIG_TARGET_EMULATION=y
CONFIG_AXXIA_GPIO=y
CONFIG_AXXIA_SPI=y
```

## configs/axm5600_sim_defconfig
```kconfig
CONFIG_ARM=y
CONFIG_TARGET_AXXIA=y
CONFIG_TARGET_SIMULATION=y
CONFIG_AXXIA_GPIO=y
CONFIG_AXXIA_SPI=y
```

## net/Kconfig
```kconfig
#
# Network configuration
#

menuconfig NET
	bool "Networking support"

if NET

config NET_RANDOM_ETHADDR
	bool "Random ethaddr if unset"
	select LIB_RAND
	help
	  Selecting this will allow the Ethernet interface to function
	  even when the ethaddr variable for that interface is unset.
	  A new MAC address will be generated on every boot and it will
	  not be added to the environment.

config NETCONSOLE
	bool "NetConsole support"
	help
	  Support the 'nc' input/output device for networked console.
	  See README.NetConsole for details.

config NET_ONCE
	bool "Setup Ethernet once"
	help
	  Setup ethernet and phy only when dhcp command is called. Prevents 
	  setup and teardown of the link for each command. 

endif   # if NET
```
